## conf/layer.conf
```bitbake
# We have a recipes directory, add to BBFILES
BBFILES += "${LAYERDIR}/recipes-*/*/*.bb"
BBFILE_COLLECTIONS += "dyplo-layer"
BBFILE_PATTERN_dyplo-layer := "^${LAYERDIR}/"
LAYERSERIES_COMPAT_dyplo-layer = "honister kirkstone langdale"
```
